## lib/cb_info/Kconfig
```kconfig
# Copyright (c) 2026 Chriesibaum GmbH
# SPDX-License-Identifier: Apache-2.0

config CB_INFO
	bool "Enable cb_zephyr_module info library"
	select HWINFO
	help
	  Enable the cb_info library provided by cb_zephyr_module.
```

## lib/cb_sys/Kconfig
```kconfig
# Copyright (c) 2026 Chriesibaum GmbH
# SPDX-License-Identifier: Apache-2.0

config CB_SYS
	bool "Enable cb_zephyr_module sys library"
	help
	  Enable the sys utility library provided by cb_zephyr_module.

config CB_SYS_LED_BLINK
	bool "Enable system LED blink mode"
	default y
	depends on CB_SYS
	help
	  Enable simple periodic blink mode using the sys_led GPIO alias.

config CB_SYS_LED_HEARTBEAT
	bool "Enable system LED heartbeat mode"
	default n
	depends on CB_SYS
	select PWM
	help
	  Enable heartbeat PWM LED mode using the sys_led_pwm alias.

config CB_SYS_LED_BPM
	int "System LED BPM"
	range 20 240
	default CB_SYS_LED_HEARTBEAT_BPM
	depends on CB_SYS && (CB_SYS_LED_HEARTBEAT || CB_SYS_LED_BLINK)
	help
	  Cycles per minute for system LED timing in heartbeat and blink modes.

config CB_SYS_LED_HEARTBEAT_BPM
	int
	default 60
	depends on CB_SYS && (CB_SYS_LED_HEARTBEAT || CB_SYS_LED_BLINK)
	help
	  Deprecated compatibility symbol. Use CB_SYS_LED_BPM.
```

## tests/cb_getting_started/twister/testcase.yaml
```yaml
tests:
  cb_getting_started.build.nucleo_u385rg_q:
    tags:
      - cb_getting_started
      - smoke
    build_only: true
    platform_allow:
      - nucleo_u385rg_q
    extra_args:
      - CONF_FILE=../../../samples/cb_getting_started/prj.conf;../../../samples/cb_getting_started/prj_log.conf

  cb_getting_started.build.rpi_pico2_rp2350a_m33:
    tags:
      - cb_getting_started
      - smoke
    build_only: true
    platform_allow:
      - rpi_pico2/rp2350a/m33
    extra_args:
      - CONF_FILE=../../../samples/cb_getting_started/prj.conf;../../../samples/cb_getting_started/prj_log.conf
```

## tests/cb_info/twister/testcase.yaml
```yaml
tests:
  cb_info.api.native_sim:
    tags:
      - cb_info
      - smoke
    harness: ztest
    platform_allow:
      - native_sim
    integration_platforms:
      - native_sim

  cb_info.api.nucleo_u385rg_q:
    tags:
      - cb_info
      - smoke
    harness: ztest
    platform_allow:
      - nucleo_u385rg_q
```

## west.yml
```yaml
manifest:

  remotes:
    - name: zephyrproject-rtos
      url-base: https://github.com/zephyrproject-rtos

  defaults:
    remote: zephyrproject-rtos

  projects:
    - name: zephyr
      revision: v4.4.0
      path: upstream/zephyr
      import: true

  self:
    path: cb_zephyr_modules.fw
```
