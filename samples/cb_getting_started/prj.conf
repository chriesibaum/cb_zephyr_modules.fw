## CMakeLists.txt
```
# Copyright (c) 2021 Teslabs Engineering S.L.
# SPDX-License-Identifier: Apache-2.0

cmake_minimum_required(VERSION 3.20.0)

# add our custom zephyr BOARD_ROOT directory
# list(APPEND BOARD_ROOT
# 	${CMAKE_CURRENT_SOURCE_DIR}/../
# )

find_package(Zephyr REQUIRED HINTS $ENV{ZEPHYR_BASE})
project(cb_black_box)

FILE(GLOB app_sources CONFIGURE_DEPENDS src/*.c)
target_sources(app PRIVATE ${app_sources})
```

## prj.conf
```kconfig
# enable CB_ZEPHYR_MODULE
CONFIG_CB_ZEPHYR_MODULE=y

# enable CB_ERROR module to get error handling and reporting features
CONFIG_CB_ERROR=y

# enable CB_SYS module to get system check functions and LED control features
CONFIG_CB_SYS=y
# CONFIG_CB_SYS_LED_BLINK=y
CONFIG_CB_SYS_LED_HEARTBEAT=y
CONFIG_CB_SYS_LED_BPM=40

# enable CB_INFO module to get build and system information features
CONFIG_CB_INFO=y
```

## prj_log.conf
```kconfig
# SPDX-License-Identifier: GPL-3.0
# Copyright (c) 2023 Chriesibaum GmbH

# serial port configuration
CONFIG_SERIAL=y
CONFIG_UART_LINE_CTRL=y
CONFIG_UART_INTERRUPT_DRIVEN=y
CONFIG_UART_USE_RUNTIME_CONFIGURE=y

# enable the boot banner
CONFIG_BOOT_BANNER=y

# enable all console and log messages
CONFIG_EARLY_CONSOLE=y
CONFIG_DEBUG=y
CONFIG_CONSOLE=y
CONFIG_UART_CONSOLE=y
CONFIG_STDOUT_CONSOLE=y


# enable logging
CONFIG_LOG=y
CONFIG_LOG_BACKEND_UART=y
CONFIG_LOG_BUFFER_SIZE=2024
CONFIG_LOG_RUNTIME_FILTERING=y
CONFIG_LOG_PROCESS_TRIGGER_THRESHOLD=0
CONFIG_CBPRINTF_FP_SUPPORT=y
CONFIG_LOG_PROCESS_THREAD=y
CONFIG_LOG_PROCESS_THREAD_SLEEP_MS=100
CONFIG_LOG_PROCESS_THREAD_STACK_SIZE=1024

# OFF: 0
# ERR: 1
# WRN: 2
# INF: 3
# DBG: 4
CONFIG_LOG_DEFAULT_LEVEL=3
```

## boards/nucleo_u385rg_q.overlay
```dts
/ {
	aliases {
		sys-led = &green_led_2;
		sys-led-pwm = &green_pwm_led;
	};

	pwmleds: pwmleds {
		status = "okay";
	};
};

&pwm2 {
	status = "okay";
};
```

## boards/rpi_pico.dtsi
```dts
/ {
	aliases {
        sys-led = &led0;
		sys-led-pwm = &pwm_led0;
	};

	pwm_leds {
		compatible = "pwm-leds";
		status = "okay";
	};
};

&pwm {
	status = "okay";
};
```

## boards/rpi_pico2_rp2350a_hazard3.overlay
```dts
#include "rpi_pico.dtsi"

#warning "rpi_pico2_rp2350a_hazard3.overlay is not ready yet: no LEDs are configured"
#error "Build blocked: configure LED aliases/nodes for this board overlay"
```

## boards/rpi_pico2_rp2350a_m33.overlay
```dts
#include "rpi_pico.dtsi"
```

## src/main.c
```c
#include <stdio.h>

#include <zephyr/kernel.h>

#include "cb_error.h"
#include "cb_sys.h"
#include "cb_info.h"

// ---- logging includes/defines ----------------------------------------------
#include <zephyr/logging/log.h>
LOG_MODULE_REGISTER(main, CONFIG_LOG_DEFAULT_LEVEL);


int32_t main(void)
{
    int ret;

    cb_info();

    ret = cb_sys_init();
    ERR_CHECK(ret < 0, ret, "cb_sys_init() failed (err %d)", ret);

    LOG_INF("   Chriesibaum's getting started sample is running fine!");
    LOG_INF("   Enjoy building on Zephyr with cb_zephyr_modules!");
    LOG_INF("   Let's have a nice cup of Café and get going with your project! :)");
    LOG_INF("   --------------------------------------------------------------------");

    while (true) {
        k_sleep(K_SECONDS(1));
    }
}
```
